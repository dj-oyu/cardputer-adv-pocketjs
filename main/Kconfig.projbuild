## main/Kconfig.projbuild
```kconfig
menu "Pocket VM (diagnostics)"

    config POCKET_VM_SELFTEST
        bool "Enable USB L lifecycle self-test"
        default n
        help
            Runs the host lifecycle test on the device via USB command L.
            Use a private sdkconfig in a dedicated build directory.

    config KSN_DEVICE_PROBE
        bool "Enable USB-triggered Kasane core regression and LCD diagnostic"
        default n
        help
            USB '~' on the home screen runs tests and opaque rectangles. Uses extra
            static storage and stack. Not a production renderer benchmark.

    config POCKET_VM_PROBE
        bool "Enable L0 VM probes (docs/vm/quickjs-freertos-vm-spec.md sec.5)"
        default n
        help
            Off by default and meant to stay that way for every normal build.
            On, this compiles in:
              - main/pocket/vmprobe.c, which samples the guest's JS memory
                usage, free heap, largest free block and ui_task's C stack
                high-water mark every 8th frame (frame time and job counts
                every frame) and logs a rate-limited
                "VMPROBE ..." summary (min/median/max over a ~1s window)
                instead of one line per frame.
              - a #ifdef-guarded probe block inside the vendored
                components/quickjs-ng/quickjs-ng/quickjs.c that exposes
                sizeof(JSStackFrame)/sizeof(JSVarRef) (private to that file)
                and a job-queue depth counter around JS_EnqueueJob /
                JS_ExecutePendingJob.
            The six USB-only L0 workloads that used to live under apps/vmprobe/
            (letters A-F) were retired once L0 finished (tag vm-L0);
            `git checkout vm-L0 -- apps/vmprobe tools/vm_l0_capture.py`
            brings them back for a re-measurement. With this on, the probe
            above now samples whatever app is actually running.
            Build a separate build_* directory with this on -- and give that
            directory its OWN sdkconfig file (-D SDKCONFIG=<dir>/sdkconfig;
            see sdkconfig.vmprobe.defaults), because ESP-IDF's default
            sdkconfig path is the project root, shared by every build_*
            directory regardless of -B. Never turn this on in
            sdkconfig.defaults or in the shared root sdkconfig.

    config POCKET_VM_RELOC
        bool "Relocatable frame segments: the explicit move API (L3a)"
        default n
        help
            Compiles in JS_VMStackRelocate, which copies the live frame
            segments to fresh addresses and rewrites every pointer that
            named the old ones (docs/vm/vm-L3-design.md, the entry ledger
            is docs/vm/vm-ledger/09-relocation-entries.md).

            Moving is only legal while the VM is parked at an L2c
            safepoint: a running JS_CallInternal keeps pointers into the
            block in C locals and registers, and the spec rules out
            guessing which machine words those are.

            The only caller is the diagnostic one: USB '&' on the home
            screen arms the next app, guest_continue_impl() then moves the
            segments before every resume, and the session logs VM_RELOC
            with what that cost. tools/vmtest/device_reloc.py drives it.
            Unarmed, a RELOC build takes the same path as a build without
            it.

            That is deliberately not a reason to move: deciding WHEN to
            relocate belongs to L4, which has to show first that the
            non-moving segments are not already enough. Off by default and
            meant to stay that way until that case is made.

            Costs, measured on this tree: flash +1,300 B, static DRAM
            +16 B against the same build with it off.

    config POCKET_VM_OOMPROBE
        bool "G12 fragmentation probe: log every failed heap allocation"
        default n
        help
            The device half of the L3/L4 decision (docs/vm/backlog.md G12):
            does fragmentation make allocations fail here? Registers the
            heap's failed-allocation hook, which walks the heap at the moment
            of every refusal and records, per heap region, whether the free
            bytes would have held the request had they been contiguous
            ("G12 FAIL ... cand=1"). Also logs every JS_TakeOOMCanary report
            ("G12 CANARY") and a per-session total ("G12 SESSION").

            Each refusal also says whether treating the VM's frame segments
            as movable would have left a long enough run ("segfix=1"):
            L3/L4 move segments and nothing else, so that is the case they
            could prevent. Adds JS_VMStackBlocks' only caller.

            Adds USB workloads on the home screen that drive the guest into
            OOM on purpose: '!' interleaved holes plus a growing large
            request, '@' a growing array between small objects, '#' JSON
            round-trips of a growing array, and '$' the negative control --
            a heap where the segments are what splits the free space.
            tools/vmtest/device_g12.py runs them and the shipped apps.

            Measurement only. Build a separate build_* directory with its own
            sdkconfig (-D SDKCONFIG=<dir>/sdkconfig).

    config POCKET_VM_STRIP_DEBUG
        bool "Compile guest JS without line tables (runtime error positions)"
        default n
        help
            The parser keeps no pc2line table for any function it compiles
            (components/quickjs-ng/quickjs-ng/quickjs.c,
            compute_pc2line_info). A runtime error's stack then names the
            file and the FIRST line of each function instead of the line
            that threw; SyntaxError and other parse errors keep their exact
            file:line (they come from the tokenizer, not the table).

            Saves the tables for every function an app keeps: measured on
            DERBY WATCH, the heap a guest keeps after evaluating is lower
            by the table's size (docs/vm/strip-debug.md). The function
            source text is already never kept (js_function_toString's note:
            that removal has no Kconfig switch of its own).

            Off by default: development builds keep exact positions. A
            shipping build may turn it on when an app needs the room.

    config POCKET_VM_GUEST_CHUNK_KB
        int "Growable guest arena: chunk size (KiB, 0 = one fixed arena)"
        range 0 64
        default 0
        help
            docs/vm/guest-memory-design.md sec.5. The guest's arena starts as
            one chunk of this size and takes another (or one of half the size)
            when full, while the system keeps the native floor; empty chunks go
            back at the end of a turn (one spare for 30 turns). Requests above
            2 KiB go to the shared heap. POCKET_VM_GUEST_ARENA_KB = 0 still
            means no arena.

    config POCKET_VM_GUEST_ARENA_KB
        int "Guest allocation arena (KiB, 0 = none)"
        range 0 128
        default 64
        help
            At guest creation, take this much internal RAM in one piece and
            make it the guest's own TLSF heap without a lock
            (docs/vm/qjs-observe.md sec.20): the guest's allocations go there
            (after the small-block cache) before heap_caps, which skips its
            region search, its heap lock and three call levels, and keeps the
            guest's small blocks out of the system heap. Taken only when the
            largest free block holds it plus 56 KiB; overlays take none. An app
            that uses less than this holds the rest until it exits.

    config POCKET_VM_HELPER_IRAM
        bool "Run the hottest QuickJS helpers from IRAM (about 8 KiB of DRAM)"
        default y
        help
            Links main/vm/helper_iram8.lf: 93 QuickJS helpers (JS_FreeValue,
            JS_GetProperty, js_malloc_rt, ...) that a JS turn fetches most per
            byte move from flash to IRAM, which on the S3 is the same pool as
            DRAM. Measured on DERBY (docs/vm/p1-iram-placement.md sec.9): the
            JS turn drops 12.1 -> 10.5 ms with the same instruction count --
            the saving is flash cache miss waits (I_STALL_BUSY -32%) -- and
            the free heap drops by 7.8 KiB.

            Turn it off to give an app those 8 KiB back. After changing the
            fragment file, run idf.py reconfigure.

    config POCKET_VM_QJS_PGO
        bool "Compile QuickJS with the profile in tools/pgo/qjs (PGO)"
        default n
        help
            Builds the QuickJS component with -fprofile-use and the .gcda
            files tools/pgo/train.sh trained on STRESS in QEMU (r5sim), so
            GCC lays each function's blocks out along the paths the training
            ran (docs/vm/qjs-pgo.md). Code size stays within ~0.4%.

            Trial: the gain is modelled in QEMU, not yet measured on the
            device. The profile only fits the GCC that trained it
            (esp-15.2.0); a stale one is reported by -Wmissing-profile.
            Build it in a directory of its own with
            sdkconfig.qjspgo.defaults layered on sdkconfig.defaults.

    config POCKET_DISP_TASK
        bool "Display task: present frames from a task of its own (two-core P1)"
        default n
        help
            docs/perf/two-core-pipeline.md, stage P1. present_frame() runs on a
            pinned task while the UI task waits for it, so nothing overlaps
            yet. With POCKET_FRAME_BD_DISP_AB the probe alternates it with the
            inline path every 60-frame window.

    config POCKET_GUEST_NATIVE_FLOOR_KB
        int "Guest limit: internal RAM left to natives (KiB, 0 = fixed limit)"
        range 0 64
        default 16
        help
            docs/vm/lv3-heap-exhaustion.md sec.5. Every native memory sample
            (100 ms) the guest's limit becomes its current bytes plus its
            arena's and small-block cache's room plus the system's free RAM
            above this floor, capped at 160 KiB. The guest then runs out as a
            quota OOM it can catch, with this much left to Kasane, the radio
            and the display, instead of at the shared heap where the refusal
            can land before an app's own try. 0 keeps the fixed limit.

    config POCKET_OOM_GC_PROBE
        bool "Probe: on a guest OOM, log who refused and the heaps before and after a full GC"
        default n
        help
            Measurement only. At most once a second, after a guest allocation
            failed: the quota/allocator refusal counts, the guest's bytes and
            the system heap (free, largest block), then the same after
            JS_RunGC. Garbage that a GC frees, live data, and a fragmented
            heap each leave a different line.

    config POCKET_HEAP_ORIGIN
        bool "Probe: name the caller of each native block that splits two large holes"
        depends on POCKET_HEAP_MAP && HEAP_TRACING_STANDALONE
        default n
        help
            Measurement only (docs/vm/lv3-heap-exhaustion.md sec.6.5). Starts
            heap tracing (leaks mode, 300 records) at boot; at the heap map
            taken before a guest, every used block in a short run (<= 8 KiB)
            between two free blocks of 2 KiB or more is printed as HEAP_PIN
            with the call stack that allocated it, or "untraced" for blocks
            older than the trace.

    config POCKET_HEAP_MAP
        bool "Probe: print the internal heap's free blocks before a guest, after its evaluation, and after it is gone"
        default n
        help
            Measurement only (docs/vm/guest-memory-design.md sec.10 step 3).
            heap_caps_walk over the internal heap at three points: before
            the guest is created (Shiki heap already taken), after the
            source is evaluated, and after the guest is destroyed (Shiki
            heap still held). Free blocks of 256 B or more are listed with
            their offsets, used blocks between them as count/bytes. A hole
            that closes when the guest is gone was cut by the guest.

    config POCKET_GC_STATS
        bool "Probe: log the guest's GC runs, time and bytes freed once a second"
        default n
        help
            Measurement only (docs/vm/guest-memory-design.md G1). Builds
            QuickJS with POCKET_GC_STATS and logs GC_STATS when a collection
            ran in the last second: runs, total and longest run in us, bytes
            freed, and the guest's usage and limit.

    config POCKET_DISP_DEFER
        bool "Display task: let the next JS turn run while a frame is presented (P2a)"
        depends on POCKET_DISP_TASK
        default y
        help
            docs/perf/two-core-pipeline.md sec.1.3 / sec.7.3. A frame that meets
            the eligibility rules is handed to the display task and the turn
            returns at once; the join happens when JS first calls a native
            function marked "join", or at the next present. Other frames are
            joined at once, as in P1.

    config POCKET_DISP_ASSERT
        bool "Display task: abort when a job is started or joined off the UI task"
        default n
        help
            docs/perf/two-core-pipeline.md sec.2.6 / sec.7.2 (F12). disp_start
            and disp_join keep their state without a lock because only the UI
            task calls them; a join on the display task itself would wait for
            ever. This checks the caller on every start and every join that
            has something to wait for.

    config POCKET_DISP_CORE
        int "Display task core"
        depends on POCKET_DISP_TASK
        range 0 1
        default 0

    config POCKET_DISP_STACK
        int "Display task stack (bytes)"
        depends on POCKET_DISP_TASK
        default 6144

    config POCKET_LCD_ISR_CORE
        int "Core the LCD SPI completion interrupt runs on (-1: the core that sets up the bus)"
        range -1 1
        default -1
        help
            Each strip sent (~30 a frame) ends in this ISR, which wakes the
            task reaping it. -1 leaves it where spi_bus_initialize() runs
            (app_main, CPU 0). The two-core pipeline (docs/perf/two-core-pipeline.md)
            measures which core should pay for it.

    config POCKET_KEY_INT_GPIO
        int "GPIO wired to the keyboard's INT (-1: none, poll the FIFO over I2C)"
        range -1 48
        default 11
        help
            The TCA8418 pulls INT low while a key event is latched; on the
            Cardputer ADV it is GPIO 11 (confirmed on the board 2026-11-11:
            the pin went low for every key event read). A poll that finds it
            high (and nothing left from the last FIFO count) skips the I2C
            read, with a count read every 20th quiet poll as a safety net
            (main/hal/board.c, board_key_event). -1 reads the FIFO every poll.

    config POCKET_KEY_INT_PROBE
        bool "Probe: read the FIFO anyway when the INT gate would skip"
        default n
        help
            Measurement only. Logs KEY_INT_MISS for every event the gate would
            have lost, and KEY_INT_STAT every 2 s. Keys are still handled.
            Needs POCKET_KEY_INT_GPIO >= 0.

    config POCKET_FRAME_BREAKDOWN
        bool "Probe: per-frame breakdown of a guest frame (JS/render/send/other/wait)"
        default n
        help
            Diagnostic (docs/perf/60fps-roadmap.md). Times every frame() period
            of a running guest and logs one "FRAME_BD" line per 60 frames:
            averages of the JS turn, render, send, the rest of app_tick, the
            rest of the UI loop and the wait, plus the worst period and how
            many periods ran past 16.7 and 33.3 ms.

    config POCKET_FRAME_BD_PRESS_AB
        bool "Probe: force the guest block cache's pressure per FRAME_BD window"
        depends on POCKET_FRAME_BREAKDOWN
        default n
        help
            Measurement only (docs/perf/frame-breakdown.md sec.7). Cycles the
            pressure that sample_memory_pressure() hands the guest block cache
            between as measured, forced on and forced off, one window each.
            Forced off keeps the cache under real native-heap pressure.

    config POCKET_FRAME_BD_LOG_AB
        bool "Probe: whole-line log writes on/off every 3 FRAME_BD windows"
        depends on POCKET_FRAME_BREAKDOWN
        default n
        help
            Measurement only (docs/perf/frame-breakdown.md sec.7). Flips
            usb_console_log_whole() so max_log compares the two paths.

    config POCKET_FRAME_BD_DISP_AB
        bool "Probe: rotate inline and display-task presents per FRAME_BD window"
        depends on POCKET_FRAME_BREAKDOWN && POCKET_DISP_TASK
        default n
        help
            Measurement only (docs/perf/two-core-pipeline.md sec.5, P1).
            Rotates inline, the task at priority 5, and the task at 6
            (input_task's, which then cannot preempt it on CPU 0).

    config POCKET_FRAME_BD_LCD_DIRECT_AB
        bool "Probe: flip the LCD send path (queue / direct) every 3 FRAME_BD windows"
        depends on POCKET_FRAME_BREAKDOWN
        default n
        help
            Measurement only. Needs BOARD_LCD_DIRECT (main/hal/board.h; on with
            POCKET_DISP_TASK):
            lcd_spi.c's register-driven sends against spi_master's queue,
            crossed with POCKET_FRAME_BD_DISP_AB's three display modes.

    config POCKET_FRAME_BD_PACE_AB
        bool "Probe: rotate the display pacing rule per FRAME_BD window"
        depends on POCKET_FRAME_BREAKDOWN
        default n
        help
            Measurement only (docs/perf/frame-breakdown.md sec.6). Cycles the
            pacing between the old rule (a one-tick yield after every
            overrun), the shipping rule (that yield only when the UI core's
            idle task starved for 500 ms), and an absolute microsecond
            deadline, one 60-frame window each.

    config POCKET_ICACHE_AB
        bool "Probe: I-cache auto-preload on/off, rotated by paint window"
        default n
        help
            Diagnostic (docs/vm/turn-icache.md sec.4). Configures the ICache
            autoload over the flash text and rotates its mode every
            KASANE_PAINT window (30 frames), logging "ICACHE_AB win=... mode=..."
            after each window, so turn_ms can be compared within one image.

    config POCKET_VM_TURNPERF
        bool "R4 probe: the JS turn's cycles against the core's own counters"
        default n
        help
            Where the frame() turn's cycles go (docs/vm/turn-cpi.md). The
            host profile counts ~0.35M x86 instructions a STRESS LV1 turn
            against ~1.7M cycles on the board, and that gap -- retiring,
            instruction fetch, data, bubbles -- decides what the next speed
            work should attack. Brackets the ordinary turn in app_tick with
            the Xtensa performance counters: PM0 counts cycles, PM1 one event
            that rotates every 30 turns, and each window logs
            "TURNPERF <event> cy=... ev=... n=... us=...".

            Measurement only. Build a separate build_* directory with its own
            sdkconfig (-D SDKCONFIG=<dir>/sdkconfig).

    config POCKET_VM_ROM_INTRINSICS
        bool "Keep the hardened builtins in flash instead of the guest heap"
        default y
        help
            The JS builtins (Object, Array, Math, ... and every method) come
            from const data in flash (quickjs-rom-intrinsics.h, written by
            tools/vmtest/floor/gen_rom_intrinsics.sh) instead of being built
            in the guest heap at each app start (docs/vm/rom-intrinsics.md
            R2). The context is born hardened (docs/vm/harden.md), and
            Array.fromAsync, Iterator.zip and Iterator.zipKeyed do not exist.

            Measured (docs/vm/rom-intrinsics.md sec.12.5): every JS app
            starts 14-22 KB smaller in the guest heap (DERBY -19.0 KB), the
            JS turn is not slower, and the image grows by about 69 KB.
            Turn it off to get the builtins built in RAM again.

            Regenerate the header after any change to the builtins.

    config POCKET_SHIKI_DEBUG
        bool "Shiki diagnostics: pocket.shikiDebug and the six test/bench apps"
        default n
        help
            Builds main/pocket/pocket_shiki.c (pocket.shikiDebug, the test-only
            surface of the Shiki engine) and main/ui/kasane/ksn_shiki_bench.c,
            and embeds the six diagnostic apps that need them or the Shiki
            self-check: apps/shikitest/{shiki_test,shiki_data_test,
            shiki_api_test,cycle_bench,draw_cost}.js and apps/meshbench/
            mesh_bench.js, with their app_registry rows and the host-launch
            (native_apps) rows. None of them is on the home menu; the USB
            broker starts them. The home menu does not change either way.

            Off by default: the product image carries none of it (about 47 KB
            of flash, estimate from the map of 4840504, docs/kasane/
            api-reorg.md sec.3.6). Turn it on for the on-device differential
            test, cycle/draw-cost probes and the mesh bench
            (docs/kasane/shiki-spec.md sec.10, apps/shikitest/README.md).

    config POCKET_DERBY_SER_PIE
        bool "Prototype: DERBY ser() chord cull in PIE, with its self-test at DERBY start"
        default y
        help
            Builds main/pocket/derby_ser_pie.c: the int16 chord-end rotation
            and chord cull (ou()) as a PIE kernel next to its scalar integer
            reference (docs/apps/derby-ser-division.md sec.10). Nothing calls
            the kernel from ser() yet. When DERBY WATCH (local.derby) gets
            pocket.derby, the session runs the self-test once, before the
            app's source is evaluated, and logs one line:
            "SERPIE ok=<n> mismatch=<n> scalar_cy=<n> pie_cy=<n> ...".
            Off by default: with it off the file compiles to nothing and the
            product image is unchanged. Use a build directory with its own
            sdkconfig (-D SDKCONFIG=<dir>/sdkconfig).

    config POCKET_SHIKI_MEMSTAT
        bool "Count the native allocations of the line/grid surfaces (diagnostic)"
        default n
        help
            main/pocket/shiki_memstat.c: what pocket_shiki_frame.c, pocket_grid.c and
            pocket_derby.c allocate, per call site, with the heap block sizes,
            the peak, and the internal heap's free bytes and largest block
            beside each allocation. app_stop() logs "SHIKI_MEM ..." lines.
            For sizing the Shiki heap's default budget (docs/kasane/shiki.md
            sec.4.5); never in the product image.

    config POCKET_UI_TASK_CORE
        int "Core the ui task is pinned to (-1 = let FreeRTOS choose)"
        range -1 1
        default 1
        help
            main/main.c's ui_task owns the whole UI, every screen and the JS
            session (docs/vm/vm-L1-design.md sec.4.1), so where it runs decides
            where every JS job runs. -1 creates it with tskNO_AFFINITY, which
            is what xTaskCreate() did here before; 0 or 1 pins it.

            The default is 1 because that is what the board measured
            (docs/vm/vm-L1-report.md sec.8, all 実測(device)): core 1 is
            indistinguishable from no affinity -- the JS turn medians match to
            0.1%, the LCD transfer to 0.04%, DIRAM to the byte -- while core 0
            costs 5.6% of a compute-bound turn, 7.6% of the transfer, and 16%
            of an HTTP request running on the other core, because core 0 is
            where ESP-IDF fixes the Wi-Fi driver task. Pinning also removes the
            one migration the board does take (measured: 1 in 1,800 idle
            frames, docs/vm/vm-L1-report.md sec.8.8).

            The three values are the SAME binary with one immediate changed --
            xTaskCreatePinnedToCore() is the only call site either way -- so a
            measurement across them is not confounded by a code-path change.

endmenu
```
