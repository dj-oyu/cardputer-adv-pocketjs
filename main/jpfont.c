#include "jpfont.h"
#include "utf8.h"
#include "esp_partition.h"
#include "esp_log.h"
#include <string.h>

// "JPF1" images, generated by tools/make_jpfont.py. Layout mirrors the SKK
// dictionary's: a fixed header, a codepoint-sorted index, then fixed-size
// records addressed by their index position.
#define JPF_MAGIC 0x3146504au

// Where each face sits in the partition. The 12 px image is 195 KB, so the
// 8 px one starts at a round 256 KB with room for the larger 14/16 px faces
// to replace it later without moving anything else.
static const size_t FONT_OFFSET[JPFONT_COUNT] = { 0x00000, 0x40000 };

typedef struct {
    uint32_t magic;
    uint16_t version;
    uint16_t cell_w;
    uint16_t cell_h;
    uint16_t baseline;
    uint32_t count;
    uint32_t cmap_off;
    uint32_t bitmap_off;
    uint32_t bitmap_len;
    uint32_t crc32;
} jpf_hdr_t;

typedef struct {
    uint16_t codepoint;
    uint8_t  advance;
    uint8_t  flags;
} jpf_cmap_t;

typedef struct {
    const uint8_t    *image;
    jpf_hdr_t         hdr;
    const jpf_cmap_t *cmap;
    const uint8_t    *bitmap;
    unsigned          stride;        // bytes per glyph row
    unsigned          glyph_bytes;
} face_t;

static face_t faces[JPFONT_COUNT];

static face_t *face(jpfont_id_t id) {
    if(id<0 || id>=JPFONT_COUNT || !faces[id].image) return NULL;
    return &faces[id];
}

bool jpfont_ready(jpfont_id_t id)     { return face(id)!=NULL; }
unsigned jpfont_cell_w(jpfont_id_t id){ face_t *f=face(id); return f?f->hdr.cell_w:0; }
unsigned jpfont_cell_h(jpfont_id_t id){ face_t *f=face(id); return f?f->hdr.cell_h:0; }
unsigned jpfont_baseline(jpfont_id_t id){ face_t *f=face(id); return f?f->hdr.baseline:0; }

// Validates and records one image. `room` is what is left of the partition.
static bool open_face(face_t *f, const uint8_t *base, size_t room) {
    if(room<sizeof(jpf_hdr_t)) return false;
    memcpy(&f->hdr,base,sizeof(f->hdr));
    if(f->hdr.magic!=JPF_MAGIC || f->hdr.version!=1) return false;
    f->stride=(f->hdr.cell_w+7)/8;
    f->glyph_bytes=f->stride*f->hdr.cell_h;
    // Bounds before any dereference: a truncated or mis-sized image must be
    // refused here rather than read past the partition later.
    if(f->hdr.count==0 || f->hdr.bitmap_len!=f->hdr.count*f->glyph_bytes ||
       f->hdr.cmap_off+f->hdr.count*sizeof(jpf_cmap_t)>room ||
       f->hdr.bitmap_off+f->hdr.bitmap_len>room)
        return false;
    f->image=base;
    f->cmap=(const jpf_cmap_t*)(base+f->hdr.cmap_off);
    f->bitmap=base+f->hdr.bitmap_off;
    return true;
}

bool jpfont_init(void) {
    const esp_partition_t *p =
        esp_partition_find_first(ESP_PARTITION_TYPE_DATA, 0x41, "jp_font");
    if(!p) { ESP_LOGW("jpfont","no jp_font partition"); return false; }
    const void *base=NULL;
    esp_partition_mmap_handle_t handle;
    esp_err_t err=esp_partition_mmap(p,0,p->size,ESP_PARTITION_MMAP_DATA,&base,&handle);
    if(err!=ESP_OK) { ESP_LOGW("jpfont","mmap failed: %s",esp_err_to_name(err)); return false; }

    unsigned loaded=0;
    for(int i=0;i<JPFONT_COUNT;i++) {
        size_t off=FONT_OFFSET[i];
        if(off>=p->size) continue;
        if(open_face(&faces[i],(const uint8_t*)base+off,p->size-off)) {
            loaded++;
            ESP_LOGI("jpfont","face %d at 0x%x: %ux%u, %u glyphs",
                     i,(unsigned)off,faces[i].hdr.cell_w,faces[i].hdr.cell_h,
                     (unsigned)faces[i].hdr.count);
        } else {
            ESP_LOGW("jpfont","no face at 0x%x",(unsigned)off);
        }
    }
    return loaded>0;
}

// gid 0 is the tofu box, so a miss resolves to it rather than to nothing.
static uint32_t gid_of(const face_t *f, uint32_t cp) {
    if(cp>0xffff) return 0;
    uint32_t lo=0, hi=f->hdr.count;
    while(lo<hi) {
        uint32_t mid=lo+(hi-lo)/2;
        if(f->cmap[mid].codepoint<cp) lo=mid+1; else hi=mid;
    }
    return (lo<f->hdr.count && f->cmap[lo].codepoint==cp) ? lo : 0;
}

bool jpfont_has(jpfont_id_t id, uint32_t cp) {
    face_t *f=face(id);
    return f && cp && gid_of(f,cp)!=0;
}

unsigned jpfont_glyph(jpfont_id_t id, uint32_t cp, uint8_t *out) {
    face_t *f=face(id);
    if(!f) return 0;
    uint32_t gid=gid_of(f,cp);
    const uint8_t *cell=f->bitmap+(size_t)gid*f->glyph_bytes;
    for(unsigned y=0;y<f->hdr.cell_h;y++)
        for(unsigned x=0;x<f->hdr.cell_w;x++)
            out[y*f->hdr.cell_w+x]=(cell[y*f->stride+x/8]&(0x80u>>(x&7)))?255:0;
    return f->cmap[gid].advance;
}

unsigned jpfont_advance(jpfont_id_t id, const char *s, size_t len, size_t i,
                        size_t *adv) {
    uint32_t cp=utf8_decode(s,len,i,adv);
    face_t *f=face(id);
    if(!f) return 0;
    return f->cmap[gid_of(f,cp)].advance;
}

unsigned jpfont_width(jpfont_id_t id, const char *s, size_t len) {
    unsigned w=0;
    for(size_t i=0;i<len;) { size_t adv; w+=jpfont_advance(id,s,len,i,&adv); i+=adv; }
    return w;
}

int jpfont_draw(jpfont_id_t id, uint16_t *pixels, int strip_y, int rows,
                int x, int y, const char *s, size_t len, uint16_t colour) {
    face_t *f=face(id);
    if(!f) return x;
    for(size_t i=0;i<len;) {
        size_t adv;
        uint32_t gid=gid_of(f,utf8_decode(s,len,i,&adv));
        i+=adv;
        const uint8_t *cell=f->bitmap+(size_t)gid*f->glyph_bytes;
        for(unsigned gy=0;gy<f->hdr.cell_h;gy++) {
            int py=y+(int)gy-strip_y;
            if(py<0||py>=rows) continue;
            uint16_t *row=pixels+(size_t)py*LCD_W;
            for(unsigned gx=0;gx<f->hdr.cell_w;gx++) {
                int px=x+(int)gx;
                if(px<0||px>=LCD_W) continue;
                if(cell[gy*f->stride+gx/8] & (0x80u>>(gx&7))) row[px]=colour;
            }
        }
        x+=f->cmap[gid].advance;
        if(x>=LCD_W) break;
    }
    return x;
}
